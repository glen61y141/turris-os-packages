## net/knot-resolver/Config.in
```kconfig
menu "Configuration"

config KNOT_RESOLVER_DYNAMIC_DOMAINS
	bool "Enable dynamic domains dependency"
	help
		Adds depency for dynamic domains
	default y

endmenu
```

## net/unbound/Config.in
```kconfig
menu "Configuration"

config UNBOUND_DYNAMIC_DOMAINS
	bool "Enable dynamic domains dependency"
	help
		Adds depency for dynamic domains
	default y

endmenu
```
